## USB-Wandler/esp32_usb_bt_bridge/sdkconfig.defaults
```kconfig
# USB Host
CONFIG_USB_HOST_CONTROL_TRANSFER_MAX_SIZE=256
CONFIG_USB_OTG_SUPPORTED=y

# FREERTOS
CONFIG_FREERTOS_HZ=1000

# Logging
CONFIG_LOG_DEFAULT_LEVEL_INFO=y

# Bluetooth aktivieren
CONFIG_BT_ENABLED=y
CONFIG_BT_BLUEDROID_ENABLED=y
CONFIG_BT_BLE_ENABLED=y

# Classic BT deaktivieren (nur BLE)
CONFIG_BT_CLASSIC_ENABLED=n
CONFIG_BT_BLE_42_FEATURES_SUPPORTED=y

# USB OTG aktivieren (für USB Host)
CONFIG_USB_OTG_SUPPORTED=y
CONFIG_USB_HOST_TASK_PRIORITY=5
```
